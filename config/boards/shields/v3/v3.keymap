#include <behaviors.dtsi>
#include <dt-bindings/zmk/keys.h>
#include<dt-bindings/zmk/bt.h>
/ {
    keymap {
        compatible = "zmk, keymap";

        default_layer {
            bindings = <
                &none           &none           &none           &none           &mo 1          &none           &none           &none           &none           &none           &none           &none           
                &none           &none           &none           &none           &none           &none           &none           &none           &none           &none           &none           &none           
                &none           &none           &none           &none           &none           &none           &none           &none           &none           &none           &none           &none           
            >;
        };

        bt_layer {
            bindings = <
                &none           &none           &none           &none           &none           &none           &none           &none           &none           &none           &none           &bootloader
                &none           &none           &none           &none           &none           &none           &none           &none           &none           &none           &none           &bt BT_CLR
                &none           &none           &none           &none           &none           &none           &none           &none           &none           &bt BT_SEL 0    &bt BT_SEL 1    &bt BT_SEL 2
            >;
        };
    };
};