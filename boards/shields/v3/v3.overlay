/ {
    chosen {
        zmk,keyboard = &keyboard;
    };
};

&keyboard {
    compatible = "zmk,keyboard";

    matrix {
        compatible = "zmk,matrix";

        /* Rows (active low) - P0_06, P0_08, P0_17, P0_20 */
        rows = <
            &gpio0 6 GPIO_ACTIVE_LOW
            &gpio0 8 GPIO_ACTIVE_LOW
            &gpio0 17 GPIO_ACTIVE_LOW
            &gpio0 20 GPIO_ACTIVE_LOW
        >;

        /* Columns (order = 031,029,002,115,113,111,010,009,106,104,011,100) */
        cols = <
            &gpio0 31 0
            &gpio0 29 0
            &gpio0 2  0
            &gpio1 15 0
            &gpio1 13 0
            &gpio1 11 0
            &gpio0 10 0
            &gpio0 9  0
            &gpio1 6  0
            &gpio1 4  0
            &gpio0 11 0
            &gpio1 0  0
        >;

        diode-direction = "col2row";
        debounce-delay-ms = <5>;
    };
};
